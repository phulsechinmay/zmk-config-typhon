## config/boards/shields/typhon/Kconfig.defconfig
```kconfig
if SHIELD_TYPHON_LEFT

# Name must be less than 16 characters long!
config ZMK_KEYBOARD_NAME
    default "Typhon"

config ZMK_SPLIT_ROLE_CENTRAL
    default y

endif

if SHIELD_TYPHON_LEFT || SHIELD_TYPHON_RIGHT

config ZMK_SPLIT
    default y

endif
```

## config/boards/shields/typhon/Kconfig.shield
```kconfig
# No whitespace after the comma or in your part name!
config SHIELD_TYPHON_LEFT
    def_bool $(shields_list_contains,typhon_left)

# No whitespace after the comma or in your part name!
config SHIELD_TYPHON_RIGHT
    def_bool $(shields_list_contains,typhon_right)
```
